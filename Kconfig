## Kconfig
```kconfig
config NXP_VETH
	tristate "NXP virtual ethernet driver support"
	help
	Enable or disable virtual ethernet driver support. To compile this driver as a module, choose 'M'.

if NXP_VETH

choice
	prompt "Select Virtual Ethernet Platform"
	default NXP_VETH_BBMINI

config NXP_VETH_BBMINI
	bool "LS2084 <--PCIe--> S32V234 (BlueBox-Mini)"
	---help---
	  Compile virtual ethernet for BlueBox-Mini board: LS2084 communicating
	  over PCIe with S32V234

config NXP_VETH_LS1043_S32GFPGA
	bool "LS1043 <--PCIe--> S32G-FPGA"
	---help---
	  Compile virtual ethernet for LS1043 board communicating over PCIe
	  with a S32G-FPGA board

endchoice

endif # NXP_VETH
```
